0,0.00174532836589831,0.00349065141522373,0.00523596383141958,0.00698126029796155,0.00872653549837393,0.0104717841162458,0.0122170008352472,0.0139621803391453,0.0157073173118207,0.0174524064372835,0.0191974423996897,0.020942419883357,0.0226873335727814,0.0244321781526532,0.0261769483078732,0.0279216387235689,0.0296662440851108,0.0314107590781283,0.0331551783885263,0.034899496702501,0.0366437087065563,0.0383878090875199,0.0401317925325597,0.0418756537291996,0.043619387365336,0.0453629881292538,0.0471064507096427,0.0488497697956133,0.0505929400767133,0.0523359562429438,0.0540788129847753,0.0558215049931638,0.0575640269595673,0.0593063735759616,0.0610485395348569,0.0627905195293134,0.064532308252958,0.0662739004000002,0.0680152906652482,0.0697564737441253,0.0714974443326859,0.0732381971276317,0.0749787268263277,0.0767190281268186,0.0784590957278449,0.0801989243288589,0.0819385086300409,0.0836778433323155,0.0854169231373675,0.0871557427476582,0.0888942968664415,0.0906325801977802,0.0923705874465616,0.0941083133185143,0.095845752520224,0.0975828997591495,0.099319749743639,0.101056297182946,0.102792536787247,0.104528463267653,0.106264071336233,0.107999355706023,0.109734311091045,0.111468932206325,0.113203213767907,0.114937150492867,0.116670737099333,0.118403968306501,0.120136838834647,0.121869343405147,0.123601476740493,0.125333233564304,0.12706460860135,0.128795596577563,0.130526192220052,0.132256390257122,0.133986185418292,0.135715572434304,0.137444546037147,0.139173100960065,0.140901231937583,0.142628933705512,0.144356201000973,0.146083028562412,0.147809411129611,0.14953534344371,0.151260820247219,0.152985836284038,0.154710386299468,0.156434465040231,0.158158067254484,0.159881187691835,0.161603821103361,0.163325962241622,0.165047605860678,0.166768746716102,0.168489379565003,0.170209499166033,0.17192910027941,0.17364817766693,0.175366726091987,0.177084740319583,0.17880221511635,0.18051914525056,0.182235525492147,0.18395135061272,0.185666615385577,0.187381314585725,0.189095442989891,0.190808995376545,0.192521966525907,0.194234351219972,0.195946144242518,0.197657340379126,0.199367934417197,0.201077921145965,0.202787295356512,0.20449605184179,0.20620418539663,0.207911690817759,0.209618562903822,0.211324796455389,0.213030386274977,0.214735327167063,0.216439613938103,0.218143241396543,0.219846204352838,0.221548497619467,0.223250116010951,0.224951054343865,0.226651307436855,0.228350870110656,0.230049737188104,0.231747903494157,0.233445363855905,0.23514211310259,0.236838146065619,0.238533457578581,0.240228042477264,0.241921895599668,0.243615011786023,0.245307385878803,0.246999012722743,0.248689887164855,0.250380004054441,0.252069358243114,0.253757944584806,0.255445757935791,0.257132793154696,0.258819045102521,0.260504508642648,0.262189178640865,0.263873049965373,0.265556117486809,0.267238376078257,0.268919820615266,0.270600445975864,0.272280247040574,0.273959218692432,0.275637355816999,0.277314653302378,0.278991106039229,0.280666708920788,0.282341456842876,0.284015344703923,0.285688367404974,0.287360519849712,0.289031796944472,0.290702193598253,0.292371704722737,0.294040325232304,0.295708050044047,0.297374874077786,0.299040792256087,0.300705799504273,0.302369890750445,0.30403306092549,0.305695304963106,0.307356617799807,0.309016994374947,0.310676429630732,0.312334918512233,0.313992455967405,0.315649036947103,0.317304656405092,0.31895930929807,0.320612990585676,0.322265695230511,0.323917418198149,0.325568154457157,0.327217898979104,0.328866646738583,0.330514392713223,0.332161131883703,0.333806859233771,0.335451569750255,0.337095258423082,0.338737920245291,0.34037955021305,0.342020143325669,0.343659694585616,0.345298198998535,0.346935651573256,0.348572047321815,0.350207381259467,0.351841648404702,0.353474843779257,0.355106962408137,0.356737999319625,0.3583679495453,0.359996808120051,0.361624570082092,0.363251230472978,0.36487678433762,0.366501226724297,0.368124552684678,0.369746757273829,0.371367835550235,0.372987782575809,0.374606593415912,0.376224263139366,0.377840786818467,0.379456159529005,0.381070376350274,0.38268343236509,0.384295322659804,0.385906042324319,0.387515586452103,0.389123950140206,0.390731128489274,0.392337116603561,0.393941909590951,0.395545502562965,0.397147890634781,0.398749068925246,0.400349032556895,0.40194777665596,0.40354529635239,0.405141586779863,0.4067366430758,0.408330460381385,0.409923033841573,0.411514358605109,0.413104429824542,0.414693242656239,0.416280792260401,0.417867073801077,0.419452082446177,0.421035813367491,0.422618261740699,0.42419942274539,0.425779291565073,0.427357863387192,0.428935133403146,0.430511096808295,0.432085748801982,0.433659084587544,0.435231099372328,0.436801788367702,0.438371146789077,0.439939169855915,0.441505852791745,0.44307119082418,0.444635179184928,0.446197813109809,0.44775908783877,0.449318998615897,0.450877540689431,0.452434709311783,0.453990499739547,0.455544907233516,0.457097927058694,0.458649554484315,0.460199784783852,0.461748613235034,0.463296035119862,0.46484204572462,0.466386640339891,0.467929814260573,0.469471562785891,0.47101188121941,0.472550764869054,0.474088209047116,0.475624209070275,0.477158760259608,0.478691857940607,0.480223497443189,0.481753674101715,0.483282383255002,0.484809620246337,0.486335380423491,0.487859659138733,0.489382451748846,0.490903753615141,0.492423560103467,0.493941866584231,0.495458668432408,0.496973961027555,0.49848773975383,0.5,0.501510737159457,0.503019946630235,0.504527623815019,0.506033764121164,0.507538362960704,0.509041415750371,0.510542917911606,0.512042864870571,0.51354125205817,0.515038074910054,0.516533328866642,0.51802700937313,0.519519111879509,0.521009631840576,0.522498564715949,0.523985905970079,0.525471651072268,0.526955795496678,0.528438334722347,0.529919264233205,0.531398579518083,0.53287627607073,0.534352349389826,0.535826794978997,0.537299608346824,0.538770785006863,0.540240320477655,0.54170821028274,0.543174449950671,0.544639035015027,0.546101961014429,0.54756322349255,0.549022817998132,0.550480740084995,0.551936985312058,0.553391549243344,0.554844427447999,0.556295615500305,0.55774510897969,0.559192903470747,0.560638994563242,0.562083377852131,0.563526048937572,0.564967003424938,0.566406236924833,0.567843745053101,0.569279523430844,0.570713567684432,0.572145873445516,0.573576436351046,0.575005252043279,0.576432316169793,0.577857624383505,0.579281172342679,0.58070295571094,0.582122970157289,0.583541211356118,0.584957674987216,0.586372356735789,0.587785252292473,0.589196357353342,0.590605667619925,0.59201317879922,0.593418886603701,0.594822786751341,0.596224874965616,0.597625146975521,0.599023598515586,0.600420225325884,0.601815023152048,0.603207987745283,0.604599114862375,0.605988400265711,0.607375839723287,0.608761429008721,0.610145163901268,0.611527040185831,0.612907053652976,0.614285200098943,0.615661475325658,0.617035875140749,0.618408395357554,0.61977903179514,0.62114778027831,0.62251463663762,0.623879596709386,0.625242656335705,0.626603811364461,0.627963057649338,0.629320391049837,0.630675807431286,0.632029302664851,0.63338087262755,0.634730513202268,0.636078220277764,0.63742398974869,0.638767817515598,0.640109699484956,0.641449631569158,0.642787609686539,0.644123629761386,0.645457687723951,0.64678977951046,0.648119901063131,0.649448048330184,0.650774217265851,0.652098403830392,0.653420603990105,0.65474081371734,0.656059028990507,0.657375245794096,0.65868946011868,0.660001667960937,0.661311865323652,0.662620048215738,0.663926212652242,0.665230354654361,0.666532470249453,0.667832555471047,0.669130606358858,0.670426618958799,0.67172058932299,0.673012513509773,0.674302387583724,0.67559020761566,0.676875969682661,0.678159669868071,0.679441304261517,0.680720868958918,0.681998360062498,0.683273773680799,0.684547105928689,0.685818352927376,0.687087510804423,0.688354575693754,0.68961954373567,0.690882411076858,0.692143173870407,0.693401828275813,0.694658370458997,0.695912796592314,0.697165102854565,0.698415285431006,0.699663340513365,0.700909264299851,0.702153052995162,0.703394702810504,0.704634209963595,0.705871570678681,0.707106781186547,0.708339837724529,0.709570736536521,0.710799473872993,0.712026045990997,0.713250449154182,0.714472679632803,0.715692733703736,0.716910607650483,0.718126297763189,0.719339800338651,0.72055111168033,0.721760228098362,0.722967145909568,0.724171861437468,0.725374371012288,0.726574670970976,0.727772757657211,0.728968627421412,0.730162276620753,0.73135370161917,0.732542898787379,0.733729864502876,0.73491459514996,0.736097087119734,0.737277336810124,0.738455340625884,0.73963109497861,0.74080459628675,0.741975840975616,0.743144825477394,0.744311546231154,0.745475999682862,0.746638182285391,0.747798090498532,0.748955720789002,0.75011106963046,0.751264133503511,0.752414908895724,0.753563392301638,0.754709580222772,0.75585346916764,0.756995055651757,0.758134336197652,0.759271307334881,0.760405965600031,0.761538307536737,0.762668329695688,0.763796028634642,0.764921400918432,0.766044443118978,0.7671651518153,0.768283523593523,0.769399555046895,0.770513242775789,0.77162458338772,0.772733573497351,0.773840209726506,0.77494448870418,0.776046407066546,0.777145961456971,0.778243148526021,0.779337964931474,0.78043040733833,0.781520472418819,0.782608156852414,0.78369345732584,0.784776370533083,0.785856893175402,0.786935021961337,0.788010753606722,0.789084084834691,0.79015501237569,0.79122353296749,0.792289643355191,0.793353340291235,0.794414620535418,0.795473480854896,0.796529918024196,0.797583928825229,0.798635510047293,0.799684658487091,0.800731370948733,0.801775644243754,0.802817475191115,0.803856860617217,0.804893797355914,0.805928282248516,0.806960312143802,0.807989883898031,0.809016994374947,0.810041640445796,0.811063818989327,0.812083526891806,0.813100761047028,0.814115518356319,0.815127795728554,0.81613759008016,0.817144898335129,0.818149717425024,0.819152044288992,0.820151875873772,0.821149209133704,0.822144041030737,0.823136368534442,0.824126188622016,0.825113498278295,0.826098294495764,0.827080574274562,0.828060334622495,0.829037572555042,0.830012285095368,0.830984469274328,0.831954122130483,0.8329212407101,0.833885822067168,0.834847863263407,0.83580736136827,0.836764313458962,0.837718716620439,0.838670567945424,0.839619864534413,0.840566603495684,0.841510781945306,0.842452397007148,0.843391445812886,0.844327925502015,0.845261833221856,0.846193166127564,0.847121921382137,0.848048096156426,0.848971687629141,0.849892692986864,0.850811109424051,0.851726934143048,0.852640164354092,0.853550797275327,0.854458830132807,0.855364260160507,0.856267084600328,0.857167300702112,0.858064905723645,0.858959896930664,0.859852271596873,0.860742027003944,0.861629160441526,0.862513669207257,0.863395550606772,0.864274801953705,0.865151420569705,0.866025403784439,0.866896748935603,0.867765453368929,0.868631514438191,0.869494929505219,0.8703556959399,0.871213811120189,0.872069272432121,0.87292207726981,0.873772223035465,0.874619707139396,0.875464527000018,0.876306680043864,0.877146163705589,0.877982975427981,0.878817112661965,0.879648572866616,0.880477353509162,0.881303452064992,0.882126866017668,0.882947592858927,0.883765630088693,0.884580975215084,0.885393625754416,0.886203579231215,0.887010833178222,0.887815385136401,0.888617232654949,0.889416373291298,0.890212804611127,0.891006524188368,0.891797529605214,0.892585818452125,0.893371388327838,0.894154236839368,0.894934361602025,0.895711760239413,0.896486430383441,0.897258369674328,0.898027575760616,0.898794046299167,0.89955777895518,0.900318771402194,0.901077021322092,0.901832526405114,0.902585284349861,0.903335292863301,0.904082549660778,0.90482705246602,0.90556879901114,0.90630778703665,0.907044014291465,0.907777478532909,0.908508177526722,0.909236109047069,0.909961270876543,0.910683660806177,0.911403276635445,0.912120116172273,0.912834177233043,0.913545457642601,0.914253955234264,0.914959667849825,0.915662593339561,0.91636272956224,0.917060074385124,0.917754625683981,0.918446381343087,0.919135339255234,0.919821497321738,0.92050485345244,0.921185405565721,0.921863151588501,0.922538089456246,0.923210217112981,0.923879532511287,0.924546033612313,0.925209718385782,0.925870584809995,0.926528630871837,0.927183854566787,0.92783625389892,0.928485826880914,0.929132571534056,0.929776485888251,0.930417567982025,0.931055815862528,0.931691227585549,0.932323801215512,0.932953534825489,0.933580426497202,0.93420447432103,0.934825676396014,0.935444030829867,0.936059535738973,0.936672189248398,0.937281989491892,0.937888934611898,0.938493022759556,0.939094252094709,0.939692620785908,0.940288127010419,0.940880768954226,0.941470544812038,0.942057452787297,0.942641491092178,0.943222657947601,0.943800951583229,0.944376370237481,0.944948912157531,0.945518575599317,0.946085358827545,0.946649260115696,0.947210277746029,0.947768410009586,0.948323655206199,0.948876011644497,0.949425477641904,0.949972051524652,0.950515731627784,0.951056516295154,0.951594403879438,0.952129392742139,0.952661481253586,0.953190667792947,0.953716950748227,0.954240328516277,0.954760799502797,0.955278362122344,0.95579301479833,0.956304755963035,0.956813584057607,0.957319497532067,0.957822494845315,0.958322574465133,0.958819734868193,0.959313974540058,0.959805291975187,0.960293685676943,0.960779154157594,0.961261695938319,0.961741309549211,0.962217993529285,0.962691746426479,0.963162566797658,0.963630453208623,0.96409540423411,0.964557418457798,0.965016494472311,0.965472630879225,0.965925826289068,0.966376079321329,0.966823388604459,0.967267752775877,0.967709170481971,0.968147640378108,0.968583161128631,0.969015731406869,0.969445349895139,0.969872015284747,0.970295726275996,0.970716481578191,0.971134279909636,0.971549119997646,0.971961000578546,0.972369920397677,0.972775878209397,0.973178872777088,0.97357890287316,0.973975967279052,0.974370064785235,0.974761194191222,0.975149354305563,0.975534543945857,0.975916761938747,0.976296007119933,0.976672278334168,0.977045574435264,0.977415894286096,0.977783236758606,0.978147600733806,0.978508985101778,0.978867388761685,0.979222810621766,0.979575249599344,0.97992470462083,0.980271174621722,0.980614658546613,0.980955155349192,0.981292663992245,0.981627183447664,0.981958712696444,0.982287250728689,0.982612796543615,0.982935349149554,0.983254907563955,0.983571470813386,0.983885037933542,0.984195607969242,0.984503179974437,0.984807753012208,0.985109326154774,0.98540789848349,0.985703469088854,0.985996037070505,0.986285601537231,0.986572161606969,0.986855716406807,0.987136265072988,0.987413806750911,0.987688340595138,0.987959865769389,0.988228381446553,0.988493886808684,0.988756381047006,0.989015863361917,0.989272332962988,0.989525789068969,0.989776230907789,0.990023657716558,0.99026806874157,0.990509463238309,0.990747840471444,0.990983199714836,0.991215540251542,0.99144486137381,0.99167116238309,0.99189444259003,0.992114701314478,0.992331937885489,0.992546151641322,0.992757341929446,0.992965508106537,0.993170649538486,0.993372765600396,0.993571855676587,0.993767919160596,0.99396095545518,0.994150963972315,0.994337944133205,0.994521895368273,0.994702817117174,0.994880708828788,0.995055569961226,0.995227399981831,0.995396198367179,0.99556196460308,0.995724698184582,0.99588439861597,0.99604106541077,0.996194698091746,0.996345296190906,0.996492859249504,0.996637386818037,0.996778878456247,0.996917333733128,0.99705275222692,0.997185133525116,0.997314477224458,0.997440782930944,0.997564050259824,0.997684278835605,0.99780146829205,0.997915618272179,0.998026728428272,0.998134798421867,0.998239827923765,0.998341816614028,0.998440764181981,0.998536670326212,0.998629534754574,0.998719357184186,0.998806137341434,0.99888987496197,0.998970569790715,0.999048221581858,0.999122830098858,0.999194395114446,0.999262916410621,0.999328393778656,0.999390827019096,0.999450215941757,0.999506560365732,0.999559860119384,0.999610115040354,0.999657324975557,0.999701489781183,0.999742609322698,0.999780683474845,0.999815712121644,0.999847695156391,0.999876632481661,0.999902524009304,0.999925369660452,0.999945169365512,0.999961923064171,0.999975630705395,0.999986292247427,0.99999390765779,0.999998476913288,1,0.999998476913288,0.99999390765779,0.999986292247427,0.999975630705395,0.999961923064171,0.999945169365512,0.999925369660452,0.999902524009304,0.999876632481661,0.999847695156391,0.999815712121644,0.999780683474845,0.999742609322698,0.999701489781183,0.999657324975557,0.999610115040354,0.999559860119384,0.999506560365732,0.999450215941757,0.999390827019096,0.999328393778656,0.999262916410621,0.999194395114446,0.999122830098858,0.999048221581858,0.998970569790715,0.99888987496197,0.998806137341434,0.998719357184186,0.998629534754574,0.998536670326212,0.998440764181981,0.998341816614028,0.998239827923765,0.998134798421867,0.998026728428272,0.997915618272179,0.99780146829205,0.997684278835605,0.997564050259824,0.997440782930944,0.997314477224458,0.997185133525116,0.99705275222692,0.996917333733128,0.996778878456247,0.996637386818037,0.996492859249504,0.996345296190906,0.996194698091746,0.99604106541077,0.99588439861597,0.995724698184582,0.99556196460308,0.995396198367179,0.995227399981831,0.995055569961226,0.994880708828788,0.994702817117174,0.994521895368273,0.994337944133205,0.994150963972315,0.99396095545518,0.993767919160596,0.993571855676587,0.993372765600396,0.993170649538486,0.992965508106537,0.992757341929446,0.992546151641322,0.992331937885489,0.992114701314478,0.99189444259003,0.99167116238309,0.99144486137381,0.991215540251542,0.990983199714836,0.990747840471444,0.990509463238309,0.99026806874157,0.990023657716558,0.989776230907789,0.989525789068969,0.989272332962988,0.989015863361917,0.988756381047006,0.988493886808684,0.988228381446553,0.987959865769389,0.987688340595138,0.987413806750911,0.987136265072988,0.986855716406807,0.986572161606969,0.986285601537231,0.985996037070505,0.985703469088854,0.98540789848349,0.985109326154774,0.984807753012208,0.984503179974437,0.984195607969242,0.983885037933542,0.983571470813386,0.983254907563955,0.982935349149554,0.982612796543615,0.982287250728689,0.981958712696444,0.981627183447664,0.981292663992245,0.980955155349192,0.980614658546613,0.980271174621722,0.97992470462083,0.979575249599344,0.979222810621766,0.978867388761685,0.978508985101778,0.978147600733806,0.977783236758606,0.977415894286096,0.977045574435264,0.976672278334168,0.976296007119933,0.975916761938747,0.975534543945857,0.975149354305563,0.974761194191222,0.974370064785235,0.973975967279052,0.97357890287316,0.973178872777088,0.972775878209397,0.972369920397677,0.971961000578546,0.971549119997646,0.971134279909636,0.970716481578191,0.970295726275996,0.969872015284747,0.969445349895139,0.969015731406869,0.968583161128631,0.968147640378108,0.967709170481971,0.967267752775877,0.966823388604459,0.966376079321329,0.965925826289068,0.965472630879225,0.965016494472311,0.964557418457798,0.96409540423411,0.963630453208623,0.963162566797658,0.962691746426479,0.962217993529285,0.961741309549211,0.961261695938319,0.960779154157594,0.960293685676943,0.959805291975187,0.959313974540058,0.958819734868193,0.958322574465133,0.957822494845315,0.957319497532067,0.956813584057607,0.956304755963036,0.95579301479833,0.955278362122344,0.954760799502797,0.954240328516277,0.953716950748227,0.953190667792947,0.952661481253586,0.952129392742139,0.951594403879438,0.951056516295154,0.950515731627784,0.949972051524653,0.949425477641904,0.948876011644497,0.948323655206199,0.947768410009586,0.947210277746029,0.946649260115696,0.946085358827545,0.945518575599317,0.944948912157531,0.944376370237481,0.943800951583229,0.943222657947601,0.942641491092178,0.942057452787297,0.941470544812038,0.940880768954225,0.940288127010419,0.939692620785908,0.939094252094709,0.938493022759556,0.937888934611898,0.937281989491892,0.936672189248398,0.936059535738973,0.935444030829867,0.934825676396014,0.934204474321029,0.933580426497202,0.932953534825489,0.932323801215512,0.931691227585549,0.931055815862528,0.930417567982025,0.929776485888251,0.929132571534056,0.928485826880913,0.92783625389892,0.927183854566787,0.926528630871837,0.925870584809995,0.925209718385782,0.924546033612313,0.923879532511287,0.923210217112981,0.922538089456246,0.9218631515885,0.921185405565721,0.92050485345244,0.919821497321738,0.919135339255234,0.918446381343087,0.917754625683981,0.917060074385124,0.91636272956224,0.915662593339561,0.914959667849825,0.914253955234264,0.913545457642601,0.912834177233043,0.912120116172273,0.911403276635445,0.910683660806177,0.909961270876543,0.909236109047068,0.908508177526722,0.907777478532909,0.907044014291465,0.90630778703665,0.90556879901114,0.904827052466019,0.904082549660778,0.903335292863301,0.902585284349861,0.901832526405114,0.901077021322092,0.900318771402193,0.89955777895518,0.898794046299167,0.898027575760616,0.897258369674328,0.89648643038344,0.895711760239413,0.894934361602025,0.894154236839368,0.893371388327838,0.892585818452125,0.891797529605214,0.891006524188368,0.890212804611126,0.889416373291297,0.888617232654949,0.887815385136401,0.887010833178222,0.886203579231215,0.885393625754416,0.884580975215084,0.883765630088693,0.882947592858927,0.882126866017668,0.881303452064992,0.880477353509162,0.879648572866616,0.878817112661965,0.877982975427981,0.877146163705589,0.876306680043863,0.875464527000018,0.874619707139396,0.873772223035465,0.87292207726981,0.872069272432121,0.871213811120189,0.8703556959399,0.869494929505219,0.868631514438191,0.867765453368928,0.866896748935603,0.866025403784439,0.865151420569704,0.864274801953705,0.863395550606772,0.862513669207257,0.861629160441526,0.860742027003944,0.859852271596873,0.858959896930664,0.858064905723644,0.857167300702112,0.856267084600328,0.855364260160507,0.854458830132807,0.853550797275327,0.852640164354092,0.851726934143047,0.850811109424051,0.849892692986864,0.848971687629142,0.848048096156426,0.847121921382137,0.846193166127564,0.845261833221856,0.844327925502015,0.843391445812886,0.842452397007147,0.841510781945306,0.840566603495684,0.839619864534413,0.838670567945424,0.837718716620439,0.836764313458962,0.83580736136827,0.834847863263407,0.833885822067168,0.832921240710099,0.831954122130482,0.830984469274328,0.830012285095368,0.829037572555042,0.828060334622494,0.827080574274562,0.826098294495764,0.825113498278295,0.824126188622016,0.823136368534442,0.822144041030737,0.821149209133704,0.820151875873772,0.819152044288992,0.818149717425023,0.817144898335129,0.81613759008016,0.815127795728554,0.814115518356319,0.813100761047028,0.812083526891806,0.811063818989327,0.810041640445796,0.809016994374947,0.80798988389803,0.806960312143802,0.805928282248516,0.804893797355914,0.803856860617217,0.802817475191114,0.801775644243754,0.800731370948733,0.79968465848709,0.798635510047293,0.797583928825228,0.796529918024196,0.795473480854896,0.794414620535418,0.793353340291235,0.792289643355191,0.79122353296749,0.79015501237569,0.789084084834691,0.788010753606722,0.786935021961337,0.785856893175402,0.784776370533083,0.78369345732584,0.782608156852414,0.781520472418819,0.78043040733833,0.779337964931474,0.778243148526021,0.777145961456971,0.776046407066546,0.774944488704179,0.773840209726506,0.772733573497351,0.77162458338772,0.770513242775789,0.769399555046895,0.768283523593523,0.7671651518153,0.766044443118978,0.764921400918432,0.763796028634642,0.762668329695688,0.761538307536737,0.760405965600031,0.759271307334881,0.758134336197652,0.756995055651756,0.75585346916764,0.754709580222772,0.753563392301638,0.752414908895724,0.751264133503511,0.750111069630459,0.748955720789002,0.747798090498532,0.746638182285391,0.745475999682862,0.744311546231154,0.743144825477394,0.741975840975616,0.74080459628675,0.73963109497861,0.738455340625884,0.737277336810124,0.736097087119734,0.73491459514996,0.733729864502876,0.732542898787379,0.731353701619171,0.730162276620753,0.728968627421411,0.727772757657211,0.726574670970976,0.725374371012288,0.724171861437468,0.722967145909568,0.721760228098362,0.72055111168033,0.719339800338651,0.718126297763189,0.716910607650483,0.715692733703736,0.714472679632803,0.713250449154182,0.712026045990997,0.710799473872992,0.709570736536521,0.708339837724529,0.707106781186548,0.705871570678681,0.704634209963595,0.703394702810504,0.702153052995163,0.700909264299851,0.699663340513366,0.698415285431006,0.697165102854564,0.695912796592314,0.694658370458997,0.693401828275813,0.692143173870406,0.690882411076858,0.68961954373567,0.688354575693754,0.687087510804423,0.685818352927376,0.684547105928689,0.683273773680799,0.681998360062499,0.680720868958918,0.679441304261516,0.678159669868071,0.676875969682661,0.67559020761566,0.674302387583724,0.673012513509773,0.67172058932299,0.670426618958799,0.669130606358858,0.667832555471047,0.666532470249452,0.665230354654361,0.663926212652241,0.662620048215737,0.661311865323652,0.660001667960937,0.65868946011868,0.657375245794096,0.656059028990507,0.65474081371734,0.653420603990105,0.652098403830392,0.650774217265851,0.649448048330184,0.648119901063131,0.646789779510459,0.645457687723951,0.644123629761387,0.642787609686539,0.641449631569158,0.640109699484955,0.638767817515597,0.63742398974869,0.636078220277764,0.634730513202268,0.63338087262755,0.632029302664851,0.630675807431286,0.629320391049837,0.627963057649338,0.62660381136446,0.625242656335705,0.623879596709386,0.62251463663762,0.621147780278311,0.61977903179514,0.618408395357554,0.617035875140749,0.615661475325658,0.614285200098943,0.612907053652976,0.611527040185831,0.610145163901268,0.608761429008721,0.607375839723287,0.605988400265711,0.604599114862375,0.603207987745282,0.601815023152048,0.600420225325884,0.599023598515586,0.597625146975521,0.596224874965616,0.594822786751341,0.593418886603701,0.592013178799219,0.590605667619925,0.589196357353342,0.587785252292473,0.586372356735789,0.584957674987215,0.583541211356117,0.58212297015729,0.58070295571094,0.579281172342679,0.577857624383505,0.576432316169793,0.575005252043278,0.573576436351046,0.572145873445516,0.570713567684431,0.569279523430844,0.567843745053101,0.566406236924833,0.564967003424938,0.563526048937571,0.56208337785213,0.560638994563242,0.559192903470747,0.55774510897969,0.556295615500305,0.554844427447999,0.553391549243344,0.551936985312058,0.550480740084996,0.549022817998132,0.54756322349255,0.546101961014429,0.544639035015027,0.543174449950671,0.54170821028274,0.540240320477655,0.538770785006863,0.537299608346824,0.535826794978997,0.534352349389826,0.53287627607073,0.531398579518083,0.529919264233205,0.528438334722347,0.526955795496677,0.525471651072268,0.523985905970079,0.522498564715949,0.521009631840577,0.519519111879509,0.51802700937313,0.516533328866642,0.515038074910054,0.51354125205817,0.512042864870571,0.510542917911605,0.509041415750371,0.507538362960704,0.506033764121164,0.504527623815019,0.503019946630235,0.501510737159457,0.5,0.49848773975383,0.496973961027555,0.495458668432407,0.493941866584231,0.492423560103467,0.490903753615141,0.489382451748846,0.487859659138733,0.486335380423491,0.484809620246337,0.483282383255003,0.481753674101715,0.480223497443189,0.478691857940607,0.477158760259609,0.475624209070276,0.474088209047116,0.472550764869054,0.47101188121941,0.469471562785891,0.467929814260573,0.466386640339891,0.464842045724619,0.463296035119862,0.461748613235034,0.460199784783852,0.458649554484315,0.457097927058694,0.455544907233516,0.453990499739547,0.452434709311783,0.450877540689431,0.449318998615897,0.44775908783877,0.446197813109809,0.444635179184927,0.443071190824179,0.441505852791745,0.439939169855915,0.438371146789077,0.436801788367702,0.435231099372327,0.433659084587544,0.432085748801982,0.430511096808295,0.428935133403146,0.427357863387192,0.425779291565072,0.42419942274539,0.422618261740699,0.421035813367491,0.419452082446177,0.417867073801077,0.416280792260401,0.414693242656239,0.413104429824542,0.411514358605109,0.409923033841573,0.408330460381385,0.4067366430758,0.405141586779862,0.40354529635239,0.40194777665596,0.400349032556895,0.398749068925246,0.39714789063478,0.395545502562965,0.393941909590951,0.392337116603561,0.390731128489274,0.389123950140206,0.387515586452103,0.385906042324319,0.384295322659804,0.38268343236509,0.381070376350274,0.379456159529005,0.377840786818467,0.376224263139366,0.374606593415912,0.372987782575809,0.371367835550234,0.369746757273829,0.368124552684678,0.366501226724297,0.364876784337619,0.363251230472978,0.361624570082092,0.359996808120051,0.3583679495453,0.356737999319625,0.355106962408137,0.353474843779257,0.351841648404702,0.350207381259468,0.348572047321815,0.346935651573256,0.345298198998535,0.343659694585616,0.342020143325669,0.34037955021305,0.338737920245291,0.337095258423082,0.335451569750255,0.333806859233771,0.332161131883703,0.330514392713223,0.328866646738583,0.327217898979104,0.325568154457157,0.323917418198149,0.322265695230511,0.320612990585676,0.31895930929807,0.317304656405092,0.315649036947102,0.313992455967405,0.312334918512232,0.310676429630732,0.309016994374948,0.307356617799807,0.305695304963106,0.30403306092549,0.302369890750445,0.300705799504273,0.299040792256086,0.297374874077786,0.295708050044046,0.294040325232304,0.292371704722737,0.290702193598252,0.289031796944471,0.287360519849712,0.285688367404973,0.284015344703923,0.282341456842876,0.280666708920788,0.278991106039229,0.277314653302378,0.275637355816999,0.273959218692432,0.272280247040574,0.270600445975864,0.268919820615266,0.267238376078257,0.265556117486809,0.263873049965373,0.262189178640865,0.260504508642649,0.258819045102521,0.257132793154696,0.25544575793579,0.253757944584805,0.252069358243113,0.250380004054441,0.248689887164854,0.246999012722743,0.245307385878802,0.243615011786022,0.241921895599668,0.240228042477263,0.238533457578581,0.236838146065619,0.23514211310259,0.233445363855906,0.231747903494157,0.230049737188104,0.228350870110656,0.226651307436855,0.224951054343865,0.223250116010951,0.221548497619467,0.219846204352837,0.218143241396542,0.216439613938103,0.214735327167063,0.213030386274976,0.211324796455388,0.209618562903822,0.207911690817759,0.206204185396629,0.20449605184179,0.202787295356512,0.201077921145965,0.199367934417197,0.197657340379126,0.195946144242518,0.194234351219972,0.192521966525908,0.190808995376545,0.189095442989891,0.187381314585725,0.185666615385577,0.18395135061272,0.182235525492148,0.180519145250559,0.178802215116349,0.177084740319583,0.175366726091987,0.17364817766693,0.171929100279409,0.170209499166032,0.168489379565002,0.166768746716102,0.165047605860678,0.163325962241622,0.161603821103361,0.159881187691835,0.158158067254484,0.156434465040231,0.154710386299468,0.152985836284038,0.151260820247219,0.14953534344371,0.147809411129611,0.146083028562411,0.144356201000973,0.142628933705511,0.140901231937582,0.139173100960065,0.137444546037146,0.135715572434304,0.133986185418292,0.132256390257122,0.130526192220052,0.128795596577562,0.12706460860135,0.125333233564304,0.123601476740493,0.121869343405148,0.120136838834647,0.118403968306501,0.116670737099333,0.114937150492867,0.113203213767907,0.111468932206325,0.109734311091045,0.107999355706023,0.106264071336233,0.104528463267654,0.102792536787246,0.101056297182946,0.0993197497436387,0.0975828997591493,0.0958457525202239,0.0941083133185139,0.0923705874465613,0.0906325801977799,0.0888942968664414,0.0871557427476582,0.0854169231373672,0.0836778433323153,0.0819385086300408,0.0801989243288589,0.0784590957278451,0.0767190281268184,0.0749787268263276,0.0732381971276317,0.071497444332686,0.0697564737441255,0.0680152906652476,0.0662739003999997,0.0645323082529576,0.0627905195293131,0.0610485395348567,0.0593063735759612,0.0575640269595669,0.0558215049931636,0.0540788129847752,0.0523359562429438,0.050592940076713,0.048849769795613,0.0471064507096425,0.0453629881292537,0.0436193873653361,0.0418756537291994,0.0401317925325596,0.0383878090875199,0.0366437087065563,0.0348994967025011,0.0331551783885261,0.0314107590781282,0.0296662440851108,0.027921638723569,0.0261769483078734,0.0244321781526526,0.022687333572781,0.0209424198833567,0.0191974423996895,0.0174524064372834,0.0157073173118203,0.013962180339145,0.012217000835247,0.0104717841162457,0.00872653549837396,0.00698126029796124,0.00523596383141938,0.00349065141522364,0.00174532836589832,5.66553889764798e-16,-0.00174532836589763,-0.00349065141522295,-0.00523596383141869,-0.006981260297961,-0.00872653549837327,-0.010471784116245,-0.0122170008352463,-0.0139621803391443,-0.01570731731182,-0.0174524064372827,-0.0191974423996892,-0.0209424198833564,-0.0226873335727807,-0.0244321781526528,-0.0261769483078727,-0.0279216387235684,-0.0296662440851101,-0.0314107590781275,-0.0331551783885259,-0.0348994967025005,-0.0366437087065557,-0.0383878090875192,-0.0401317925325589,-0.0418756537291991,-0.0436193873653354,-0.0453629881292531,-0.0471064507096418,-0.0488497697956123,-0.0505929400767127,-0.0523359562429431,-0.0540788129847745,-0.0558215049931629,-0.0575640269595662,-0.0593063735759614,-0.0610485395348565,-0.0627905195293129,-0.0645323082529574,-0.0662739003999994,-0.0680152906652478,-0.0697564737441248,-0.0714974443326853,-0.073238197127631,-0.0749787268263269,-0.0767190281268182,-0.0784590957278444,-0.0801989243288583,-0.0819385086300401,-0.0836778433323146,-0.0854169231373669,-0.0871557427476575,-0.0888942968664408,-0.0906325801977793,-0.0923705874465606,-0.0941083133185137,-0.0958457525202232,-0.097582899759149,-0.0993197497436385,-0.101056297182946,-0.102792536787247,-0.104528463267653,-0.106264071336233,-0.107999355706022,-0.109734311091045,-0.111468932206325,-0.113203213767906,-0.114937150492866,-0.116670737099332,-0.1184039683065,-0.120136838834647,-0.121869343405147,-0.123601476740492,-0.125333233564303,-0.12706460860135,-0.128795596577562,-0.130526192220051,-0.132256390257122,-0.133986185418291,-0.135715572434303,-0.137444546037146,-0.139173100960065,-0.140901231937582,-0.142628933705511,-0.144356201000973,-0.146083028562411,-0.14780941112961,-0.149535343443709,-0.151260820247219,-0.152985836284037,-0.154710386299468,-0.15643446504023,-0.158158067254483,-0.159881187691834,-0.16160382110336,-0.163325962241622,-0.165047605860677,-0.166768746716102,-0.168489379565002,-0.170209499166032,-0.171929100279409,-0.17364817766693,-0.175366726091987,-0.177084740319583,-0.178802215116349,-0.18051914525056,-0.182235525492147,-0.18395135061272,-0.185666615385577,-0.187381314585724,-0.189095442989891,-0.190808995376544,-0.192521966525907,-0.194234351219971,-0.195946144242517,-0.197657340379126,-0.199367934417197,-0.201077921145964,-0.202787295356512,-0.204496051841789,-0.206204185396629,-0.207911690817759,-0.209618562903821,-0.211324796455388,-0.213030386274976,-0.214735327167063,-0.216439613938103,-0.218143241396542,-0.219846204352837,-0.221548497619467,-0.223250116010951,-0.224951054343865,-0.226651307436854,-0.228350870110655,-0.230049737188104,-0.231747903494157,-0.233445363855905,-0.235142113102589,-0.236838146065618,-0.23853345757858,-0.240228042477263,-0.241921895599667,-0.243615011786022,-0.245307385878802,-0.246999012722742,-0.248689887164854,-0.250380004054441,-0.252069358243113,-0.253757944584805,-0.25544575793579,-0.257132793154696,-0.25881904510252,-0.260504508642648,-0.262189178640864,-0.263873049965372,-0.265556117486808,-0.267238376078256,-0.268919820615265,-0.270600445975863,-0.272280247040574,-0.273959218692432,-0.275637355816999,-0.277314653302377,-0.278991106039228,-0.280666708920787,-0.282341456842876,-0.284015344703922,-0.285688367404973,-0.287360519849711,-0.289031796944471,-0.290702193598252,-0.292371704722736,-0.294040325232304,-0.295708050044046,-0.297374874077785,-0.299040792256086,-0.300705799504273,-0.302369890750444,-0.30403306092549,-0.305695304963105,-0.307356617799807,-0.309016994374947,-0.310676429630731,-0.312334918512232,-0.313992455967404,-0.315649036947102,-0.317304656405091,-0.318959309298069,-0.320612990585675,-0.32226569523051,-0.323917418198149,-0.325568154457156,-0.327217898979104,-0.328866646738583,-0.330514392713222,-0.332161131883703,-0.333806859233771,-0.335451569750254,-0.337095258423081,-0.338737920245291,-0.34037955021305,-0.342020143325668,-0.343659694585615,-0.345298198998534,-0.346935651573255,-0.348572047321815,-0.350207381259467,-0.351841648404701,-0.353474843779256,-0.355106962408136,-0.356737999319625,-0.3583679495453,-0.35999680812005,-0.361624570082091,-0.363251230472977,-0.364876784337619,-0.366501226724297,-0.368124552684677,-0.369746757273829,-0.371367835550234,-0.372987782575809,-0.374606593415912,-0.376224263139365,-0.377840786818466,-0.379456159529004,-0.381070376350274,-0.382683432365089,-0.384295322659803,-0.385906042324318,-0.387515586452102,-0.389123950140206,-0.390731128489273,-0.392337116603561,-0.39394190959095,-0.395545502562964,-0.39714789063478,-0.398749068925246,-0.400349032556895,-0.40194777665596,-0.403545296352389,-0.405141586779862,-0.4067366430758,-0.408330460381384,-0.409923033841572,-0.411514358605108,-0.413104429824541,-0.414693242656239,-0.416280792260401,-0.417867073801076,-0.419452082446176,-0.421035813367491,-0.422618261740699,-0.42419942274539,-0.425779291565072,-0.427357863387192,-0.428935133403145,-0.430511096808294,-0.432085748801982,-0.433659084587543,-0.435231099372327,-0.436801788367702,-0.438371146789077,-0.439939169855915,-0.441505852791745,-0.443071190824179,-0.444635179184927,-0.446197813109808,-0.447759087838769,-0.449318998615896,-0.45087754068943,-0.452434709311782,-0.453990499739546,-0.455544907233515,-0.457097927058693,-0.458649554484315,-0.460199784783851,-0.461748613235033,-0.463296035119861,-0.464842045724619,-0.466386640339891,-0.467929814260573,-0.46947156278589,-0.47101188121941,-0.472550764869054,-0.474088209047116,-0.475624209070275,-0.477158760259608,-0.478691857940606,-0.480223497443188,-0.481753674101715,-0.483282383255002,-0.484809620246337,-0.48633538042349,-0.487859659138732,-0.489382451748846,-0.49090375361514,-0.492423560103467,-0.49394186658423,-0.495458668432407,-0.496973961027555,-0.49848773975383,-0.499999999999999,-0.501510737159457,-0.503019946630234,-0.504527623815019,-0.506033764121164,-0.507538362960704,-0.509041415750371,-0.510542917911605,-0.512042864870571,-0.51354125205817,-0.515038074910054,-0.516533328866641,-0.51802700937313,-0.519519111879509,-0.521009631840576,-0.522498564715948,-0.523985905970079,-0.525471651072267,-0.526955795496677,-0.528438334722347,-0.529919264233204,-0.531398579518082,-0.532876276070729,-0.534352349389826,-0.535826794978996,-0.537299608346824,-0.538770785006863,-0.540240320477655,-0.54170821028274,-0.54317444995067,-0.544639035015027,-0.546101961014429,-0.54756322349255,-0.549022817998131,-0.550480740084995,-0.551936985312058,-0.553391549243344,-0.554844427447999,-0.556295615500304,-0.55774510897969,-0.559192903470746,-0.560638994563241,-0.56208337785213,-0.563526048937571,-0.564967003424937,-0.566406236924832,-0.567843745053101,-0.569279523430843,-0.570713567684431,-0.572145873445516,-0.573576436351046,-0.575005252043278,-0.576432316169793,-0.577857624383505,-0.579281172342679,-0.580702955710939,-0.582122970157289,-0.583541211356117,-0.584957674987215,-0.586372356735789,-0.587785252292473,-0.589196357353342,-0.590605667619925,-0.592013178799219,-0.593418886603701,-0.594822786751341,-0.596224874965615,-0.59762514697552,-0.599023598515585,-0.600420225325883,-0.601815023152048,-0.603207987745282,-0.604599114862374,-0.605988400265711,-0.607375839723286,-0.60876142900872,-0.610145163901267,-0.611527040185831,-0.612907053652976,-0.614285200098943,-0.615661475325658,-0.617035875140748,-0.618408395357554,-0.61977903179514,-0.62114778027831,-0.622514636637619,-0.623879596709386,-0.625242656335705,-0.62660381136446,-0.627963057649337,-0.629320391049837,-0.630675807431286,-0.63202930266485,-0.63338087262755,-0.634730513202267,-0.636078220277764,-0.637423989748689,-0.638767817515597,-0.640109699484955,-0.641449631569158,-0.642787609686539,-0.644123629761386,-0.64545768772395,-0.646789779510459,-0.648119901063131,-0.649448048330183,-0.65077421726585,-0.652098403830392,-0.653420603990105,-0.654740813717339,-0.656059028990507,-0.657375245794095,-0.65868946011868,-0.660001667960936,-0.661311865323651,-0.662620048215737,-0.663926212652241,-0.66523035465436,-0.666532470249452,-0.667832555471046,-0.669130606358858,-0.670426618958799,-0.67172058932299,-0.673012513509773,-0.674302387583723,-0.67559020761566,-0.67687596968266,-0.67815966986807,-0.679441304261516,-0.680720868958917,-0.681998360062498,-0.683273773680799,-0.684547105928688,-0.685818352927376,-0.687087510804423,-0.688354575693753,-0.689619543735669,-0.690882411076858,-0.692143173870407,-0.693401828275813,-0.694658370458997,-0.695912796592314,-0.697165102854564,-0.698415285431006,-0.699663340513365,-0.700909264299851,-0.702153052995162,-0.703394702810503,-0.704634209963594,-0.705871570678681,-0.707106781186547,-0.708339837724528,-0.70957073653652,-0.710799473872992,-0.712026045990996,-0.713250449154181,-0.714472679632803,-0.715692733703735,-0.716910607650482,-0.718126297763189,-0.719339800338651,-0.72055111168033,-0.721760228098362,-0.722967145909568,-0.724171861437467,-0.725374371012287,-0.726574670970976,-0.72777275765721,-0.728968627421411,-0.730162276620752,-0.73135370161917,-0.732542898787378,-0.733729864502876,-0.73491459514996,-0.736097087119734,-0.737277336810124,-0.738455340625883,-0.739631094978609,-0.74080459628675,-0.741975840975616,-0.743144825477394,-0.744311546231153,-0.745475999682862,-0.746638182285391,-0.747798090498532,-0.748955720789002,-0.750111069630459,-0.751264133503511,-0.752414908895724,-0.753563392301638,-0.754709580222772,-0.755853469167639,-0.756995055651756,-0.758134336197652,-0.75927130733488,-0.760405965600031,-0.761538307536736,-0.762668329695688,-0.763796028634642,-0.764921400918432,-0.766044443118978,-0.767165151815299,-0.768283523593523,-0.769399555046895,-0.770513242775789,-0.771624583387719,-0.77273357349735,-0.773840209726506,-0.774944488704179,-0.776046407066546,-0.777145961456971,-0.778243148526021,-0.779337964931474,-0.780430407338329,-0.781520472418818,-0.782608156852413,-0.783693457325839,-0.784776370533083,-0.785856893175402,-0.786935021961337,-0.788010753606722,-0.78908408483469,-0.79015501237569,-0.791223532967489,-0.792289643355191,-0.793353340291235,-0.794414620535418,-0.795473480854896,-0.796529918024196,-0.797583928825228,-0.798635510047292,-0.79968465848709,-0.800731370948733,-0.801775644243753,-0.802817475191114,-0.803856860617217,-0.804893797355914,-0.805928282248516,-0.806960312143801,-0.807989883898031,-0.809016994374947,-0.810041640445796,-0.811063818989326,-0.812083526891806,-0.813100761047027,-0.814115518356319,-0.815127795728554,-0.81613759008016,-0.817144898335128,-0.818149717425023,-0.819152044288992,-0.820151875873772,-0.821149209133704,-0.822144041030737,-0.823136368534441,-0.824126188622015,-0.825113498278295,-0.826098294495764,-0.827080574274561,-0.828060334622494,-0.829037572555041,-0.830012285095367,-0.830984469274328,-0.831954122130482,-0.832921240710099,-0.833885822067168,-0.834847863263406,-0.83580736136827,-0.836764313458961,-0.837718716620438,-0.838670567945424,-0.839619864534413,-0.840566603495684,-0.841510781945306,-0.842452397007147,-0.843391445812885,-0.844327925502015,-0.845261833221856,-0.846193166127564,-0.847121921382137,-0.848048096156426,-0.848971687629141,-0.849892692986864,-0.850811109424051,-0.851726934143047,-0.852640164354092,-0.853550797275327,-0.854458830132807,-0.855364260160506,-0.856267084600328,-0.857167300702112,-0.858064905723644,-0.858959896930664,-0.859852271596873,-0.860742027003943,-0.861629160441525,-0.862513669207257,-0.863395550606772,-0.864274801953704,-0.865151420569704,-0.866025403784438,-0.866896748935603,-0.867765453368928,-0.868631514438191,-0.869494929505219,-0.870355695939899,-0.871213811120189,-0.87206927243212,-0.872922077269809,-0.873772223035465,-0.874619707139396,-0.875464527000018,-0.876306680043864,-0.877146163705588,-0.87798297542798,-0.878817112661965,-0.879648572866616,-0.880477353509162,-0.881303452064992,-0.882126866017667,-0.882947592858927,-0.883765630088693,-0.884580975215084,-0.885393625754415,-0.886203579231215,-0.887010833178221,-0.887815385136401,-0.888617232654949,-0.889416373291297,-0.890212804611127,-0.891006524188368,-0.891797529605214,-0.892585818452125,-0.893371388327837,-0.894154236839368,-0.894934361602025,-0.895711760239412,-0.896486430383441,-0.897258369674328,-0.898027575760616,-0.898794046299167,-0.89955777895518,-0.900318771402193,-0.901077021322091,-0.901832526405113,-0.90258528434986,-0.9033352928633,-0.904082549660778,-0.904827052466019,-0.905568799011139,-0.90630778703665,-0.907044014291465,-0.907777478532909,-0.908508177526721,-0.909236109047069,-0.909961270876543,-0.910683660806177,-0.911403276635445,-0.912120116172273,-0.912834177233043,-0.913545457642601,-0.914253955234263,-0.914959667849825,-0.915662593339561,-0.91636272956224,-0.917060074385124,-0.917754625683981,-0.918446381343087,-0.919135339255234,-0.919821497321737,-0.92050485345244,-0.921185405565721,-0.9218631515885,-0.922538089456246,-0.923210217112981,-0.923879532511287,-0.924546033612313,-0.925209718385782,-0.925870584809994,-0.926528630871837,-0.927183854566787,-0.92783625389892,-0.928485826880913,-0.929132571534056,-0.929776485888251,-0.930417567982024,-0.931055815862528,-0.931691227585549,-0.932323801215512,-0.932953534825489,-0.933580426497202,-0.934204474321029,-0.934825676396014,-0.935444030829867,-0.936059535738973,-0.936672189248397,-0.937281989491891,-0.937888934611897,-0.938493022759556,-0.939094252094709,-0.939692620785908,-0.940288127010419,-0.940880768954225,-0.941470544812038,-0.942057452787297,-0.942641491092178,-0.943222657947601,-0.943800951583229,-0.944376370237481,-0.944948912157531,-0.945518575599317,-0.946085358827545,-0.946649260115696,-0.947210277746028,-0.947768410009586,-0.948323655206199,-0.948876011644496,-0.949425477641904,-0.949972051524652,-0.950515731627784,-0.951056516295154,-0.951594403879438,-0.952129392742139,-0.952661481253586,-0.953190667792947,-0.953716950748227,-0.954240328516277,-0.954760799502797,-0.955278362122343,-0.95579301479833,-0.956304755963035,-0.956813584057607,-0.957319497532067,-0.957822494845315,-0.958322574465133,-0.958819734868193,-0.959313974540057,-0.959805291975187,-0.960293685676943,-0.960779154157594,-0.961261695938319,-0.961741309549211,-0.962217993529285,-0.962691746426479,-0.963162566797658,-0.963630453208623,-0.96409540423411,-0.964557418457798,-0.965016494472311,-0.965472630879225,-0.965925826289068,-0.966376079321329,-0.966823388604459,-0.967267752775877,-0.967709170481971,-0.968147640378108,-0.968583161128631,-0.969015731406869,-0.969445349895139,-0.969872015284747,-0.970295726275996,-0.97071648157819,-0.971134279909636,-0.971549119997646,-0.971961000578546,-0.972369920397677,-0.972775878209396,-0.973178872777088,-0.97357890287316,-0.973975967279052,-0.974370064785235,-0.974761194191222,-0.975149354305563,-0.975534543945856,-0.975916761938747,-0.976296007119933,-0.976672278334168,-0.977045574435264,-0.977415894286096,-0.977783236758606,-0.978147600733806,-0.978508985101778,-0.978867388761685,-0.979222810621766,-0.979575249599344,-0.97992470462083,-0.980271174621722,-0.980614658546613,-0.980955155349192,-0.981292663992245,-0.981627183447664,-0.981958712696444,-0.982287250728689,-0.982612796543615,-0.982935349149554,-0.983254907563955,-0.983571470813386,-0.983885037933542,-0.984195607969242,-0.984503179974436,-0.984807753012208,-0.985109326154774,-0.98540789848349,-0.985703469088853,-0.985996037070505,-0.986285601537231,-0.986572161606969,-0.986855716406807,-0.987136265072988,-0.987413806750911,-0.987688340595138,-0.987959865769389,-0.988228381446553,-0.988493886808683,-0.988756381047006,-0.989015863361917,-0.989272332962988,-0.989525789068969,-0.989776230907789,-0.990023657716558,-0.99026806874157,-0.990509463238309,-0.990747840471443,-0.990983199714836,-0.991215540251542,-0.99144486137381,-0.99167116238309,-0.99189444259003,-0.992114701314478,-0.992331937885489,-0.992546151641322,-0.992757341929445,-0.992965508106537,-0.993170649538486,-0.993372765600396,-0.993571855676587,-0.993767919160596,-0.99396095545518,-0.994150963972315,-0.994337944133205,-0.994521895368273,-0.994702817117174,-0.994880708828788,-0.995055569961226,-0.995227399981831,-0.995396198367179,-0.99556196460308,-0.995724698184582,-0.99588439861597,-0.99604106541077,-0.996194698091746,-0.996345296190906,-0.996492859249504,-0.996637386818036,-0.996778878456247,-0.996917333733128,-0.99705275222692,-0.997185133525116,-0.997314477224458,-0.997440782930944,-0.997564050259824,-0.997684278835605,-0.99780146829205,-0.997915618272179,-0.998026728428272,-0.998134798421867,-0.998239827923765,-0.998341816614028,-0.998440764181981,-0.998536670326212,-0.998629534754574,-0.998719357184186,-0.998806137341434,-0.99888987496197,-0.998970569790715,-0.999048221581858,-0.999122830098858,-0.999194395114446,-0.999262916410621,-0.999328393778656,-0.999390827019096,-0.999450215941757,-0.999506560365732,-0.999559860119384,-0.999610115040354,-0.999657324975557,-0.999701489781183,-0.999742609322698,-0.999780683474845,-0.999815712121644,-0.999847695156391,-0.999876632481661,-0.999902524009304,-0.999925369660452,-0.999945169365512,-0.999961923064171,-0.999975630705395,-0.999986292247427,-0.99999390765779,-0.999998476913288,-1,-0.999998476913288,-0.99999390765779,-0.999986292247427,-0.999975630705395,-0.999961923064171,-0.999945169365512,-0.999925369660452,-0.999902524009304,-0.999876632481661,-0.999847695156391,-0.999815712121644,-0.999780683474845,-0.999742609322698,-0.999701489781183,-0.999657324975557,-0.999610115040354,-0.999559860119384,-0.999506560365732,-0.999450215941757,-0.999390827019096,-0.999328393778656,-0.999262916410621,-0.999194395114446,-0.999122830098858,-0.999048221581858,-0.998970569790715,-0.99888987496197,-0.998806137341434,-0.998719357184186,-0.998629534754574,-0.998536670326212,-0.998440764181981,-0.998341816614028,-0.998239827923765,-0.998134798421867,-0.998026728428272,-0.997915618272179,-0.99780146829205,-0.997684278835605,-0.997564050259824,-0.997440782930944,-0.997314477224458,-0.997185133525116,-0.99705275222692,-0.996917333733128,-0.996778878456247,-0.996637386818037,-0.996492859249504,-0.996345296190906,-0.996194698091746,-0.99604106541077,-0.99588439861597,-0.995724698184582,-0.99556196460308,-0.995396198367179,-0.995227399981831,-0.995055569961226,-0.994880708828788,-0.994702817117174,-0.994521895368273,-0.994337944133205,-0.994150963972316,-0.99396095545518,-0.993767919160596,-0.993571855676588,-0.993372765600396,-0.993170649538486,-0.992965508106537,-0.992757341929446,-0.992546151641322,-0.992331937885489,-0.992114701314478,-0.99189444259003,-0.99167116238309,-0.99144486137381,-0.991215540251542,-0.990983199714836,-0.990747840471444,-0.990509463238309,-0.99026806874157,-0.990023657716558,-0.989776230907789,-0.98952578906897,-0.989272332962988,-0.989015863361917,-0.988756381047006,-0.988493886808684,-0.988228381446553,-0.987959865769389,-0.987688340595138,-0.987413806750912,-0.987136265072988,-0.986855716406807,-0.986572161606969,-0.986285601537231,-0.985996037070505,-0.985703469088854,-0.98540789848349,-0.985109326154774,-0.984807753012208,-0.984503179974437,-0.984195607969242,-0.983885037933542,-0.983571470813386,-0.983254907563955,-0.982935349149554,-0.982612796543615,-0.982287250728689,-0.981958712696444,-0.981627183447664,-0.981292663992245,-0.980955155349192,-0.980614658546613,-0.980271174621722,-0.97992470462083,-0.979575249599344,-0.979222810621766,-0.978867388761685,-0.978508985101779,-0.978147600733806,-0.977783236758606,-0.977415894286096,-0.977045574435264,-0.976672278334168,-0.976296007119933,-0.975916761938748,-0.975534543945857,-0.975149354305563,-0.974761194191222,-0.974370064785235,-0.973975967279052,-0.97357890287316,-0.973178872777088,-0.972775878209397,-0.972369920397677,-0.971961000578546,-0.971549119997646,-0.971134279909636,-0.970716481578191,-0.970295726275997,-0.969872015284747,-0.969445349895139,-0.96901573140687,-0.968583161128631,-0.968147640378108,-0.967709170481971,-0.967267752775877,-0.96682338860446,-0.966376079321329,-0.965925826289068,-0.965472630879225,-0.965016494472312,-0.964557418457798,-0.96409540423411,-0.963630453208623,-0.963162566797658,-0.962691746426479,-0.962217993529285,-0.961741309549212,-0.961261695938319,-0.960779154157594,-0.960293685676943,-0.959805291975187,-0.959313974540058,-0.958819734868193,-0.958322574465133,-0.957822494845315,-0.957319497532067,-0.956813584057608,-0.956304755963035,-0.95579301479833,-0.955278362122344,-0.954760799502798,-0.954240328516277,-0.953716950748227,-0.953190667792947,-0.952661481253586,-0.952129392742139,-0.951594403879438,-0.951056516295154,-0.950515731627784,-0.949972051524653,-0.949425477641904,-0.948876011644497,-0.948323655206199,-0.947768410009586,-0.947210277746029,-0.946649260115697,-0.946085358827545,-0.945518575599317,-0.944948912157531,-0.944376370237481,-0.94380095158323,-0.943222657947601,-0.942641491092178,-0.942057452787297,-0.941470544812038,-0.940880768954226,-0.940288127010419,-0.939692620785908,-0.939094252094709,-0.938493022759556,-0.937888934611898,-0.937281989491892,-0.936672189248398,-0.936059535738973,-0.935444030829867,-0.934825676396015,-0.93420447432103,-0.933580426497202,-0.932953534825489,-0.932323801215512,-0.931691227585549,-0.931055815862528,-0.930417567982025,-0.929776485888252,-0.929132571534056,-0.928485826880914,-0.92783625389892,-0.927183854566787,-0.926528630871838,-0.925870584809995,-0.925209718385783,-0.924546033612313,-0.923879532511287,-0.923210217112981,-0.922538089456246,-0.921863151588501,-0.921185405565721,-0.92050485345244,-0.919821497321738,-0.919135339255235,-0.918446381343087,-0.917754625683981,-0.917060074385124,-0.91636272956224,-0.915662593339561,-0.914959667849825,-0.914253955234264,-0.913545457642601,-0.912834177233043,-0.912120116172273,-0.911403276635446,-0.910683660806177,-0.909961270876543,-0.909236109047069,-0.908508177526722,-0.907777478532909,-0.907044014291465,-0.90630778703665,-0.90556879901114,-0.90482705246602,-0.904082549660779,-0.903335292863301,-0.902585284349861,-0.901832526405114,-0.901077021322092,-0.900318771402194,-0.899557778955181,-0.898794046299167,-0.898027575760616,-0.897258369674328,-0.896486430383441,-0.895711760239413,-0.894934361602025,-0.894154236839368,-0.893371388327837,-0.892585818452126,-0.891797529605214,-0.891006524188368,-0.890212804611127,-0.889416373291298,-0.888617232654949,-0.887815385136402,-0.887010833178222,-0.886203579231215,-0.885393625754416,-0.884580975215084,-0.883765630088694,-0.882947592858927,-0.882126866017668,-0.881303452064992,-0.880477353509162,-0.879648572866617,-0.878817112661965,-0.877982975427981,-0.877146163705589,-0.876306680043864,-0.875464527000018,-0.874619707139396,-0.873772223035466,-0.87292207726981,-0.872069272432121,-0.871213811120189,-0.8703556959399,-0.869494929505219,-0.868631514438192,-0.867765453368929,-0.866896748935603,-0.866025403784439,-0.865151420569705,-0.864274801953705,-0.863395550606772,-0.862513669207258,-0.861629160441526,-0.860742027003944,-0.859852271596874,-0.858959896930665,-0.858064905723645,-0.857167300702112,-0.856267084600329,-0.855364260160507,-0.854458830132808,-0.853550797275328,-0.852640164354092,-0.851726934143048,-0.850811109424051,-0.849892692986864,-0.848971687629142,-0.848048096156426,-0.847121921382137,-0.846193166127564,-0.845261833221856,-0.844327925502016,-0.843391445812886,-0.842452397007148,-0.841510781945306,-0.840566603495685,-0.839619864534413,-0.838670567945424,-0.837718716620439,-0.836764313458962,-0.835807361368271,-0.834847863263407,-0.833885822067168,-0.8329212407101,-0.831954122130483,-0.830984469274329,-0.830012285095368,-0.829037572555042,-0.828060334622495,-0.827080574274562,-0.826098294495764,-0.825113498278295,-0.824126188622016,-0.823136368534442,-0.822144041030738,-0.821149209133704,-0.820151875873773,-0.819152044288992,-0.818149717425024,-0.817144898335129,-0.816137590080161,-0.815127795728554,-0.814115518356319,-0.813100761047028,-0.812083526891806,-0.811063818989327,-0.810041640445796,-0.809016994374948,-0.807989883898031,-0.806960312143802,-0.805928282248516,-0.804893797355914,-0.803856860617217,-0.802817475191115,-0.801775644243754,-0.800731370948734,-0.799684658487091,-0.798635510047293,-0.797583928825229,-0.796529918024197,-0.795473480854896,-0.794414620535419,-0.793353340291235,-0.792289643355191,-0.79122353296749,-0.790155012375691,-0.789084084834691,-0.788010753606722,-0.786935021961338,-0.785856893175402,-0.784776370533083,-0.78369345732584,-0.782608156852414,-0.781520472418819,-0.78043040733833,-0.779337964931474,-0.778243148526021,-0.777145961456971,-0.776046407066546,-0.77494448870418,-0.773840209726507,-0.772733573497351,-0.77162458338772,-0.77051324277579,-0.769399555046896,-0.768283523593524,-0.7671651518153,-0.766044443118978,-0.764921400918433,-0.763796028634642,-0.762668329695689,-0.761538307536737,-0.760405965600031,-0.759271307334881,-0.758134336197652,-0.756995055651757,-0.75585346916764,-0.754709580222772,-0.753563392301638,-0.752414908895725,-0.751264133503512,-0.75011106963046,-0.748955720789002,-0.747798090498533,-0.746638182285391,-0.745475999682863,-0.744311546231154,-0.743144825477395,-0.741975840975617,-0.740804596286751,-0.73963109497861,-0.738455340625884,-0.737277336810124,-0.736097087119735,-0.73491459514996,-0.733729864502877,-0.732542898787379,-0.73135370161917,-0.730162276620753,-0.728968627421412,-0.727772757657211,-0.726574670970976,-0.725374371012288,-0.724171861437468,-0.722967145909569,-0.721760228098363,-0.720551111680331,-0.719339800338651,-0.718126297763189,-0.716910607650483,-0.715692733703737,-0.714472679632804,-0.713250449154181,-0.712026045990997,-0.710799473872992,-0.709570736536522,-0.708339837724529,-0.707106781186548,-0.705871570678681,-0.704634209963595,-0.703394702810504,-0.702153052995163,-0.700909264299851,-0.699663340513366,-0.698415285431006,-0.697165102854565,-0.695912796592315,-0.694658370458998,-0.693401828275813,-0.692143173870407,-0.690882411076859,-0.68961954373567,-0.688354575693754,-0.687087510804424,-0.685818352927376,-0.68454710592869,-0.683273773680799,-0.681998360062498,-0.680720868958918,-0.679441304261516,-0.678159669868071,-0.676875969682661,-0.67559020761566,-0.674302387583724,-0.673012513509774,-0.671720589322991,-0.6704266189588,-0.669130606358858,-0.667832555471047,-0.666532470249453,-0.665230354654362,-0.663926212652242,-0.662620048215738,-0.661311865323652,-0.660001667960937,-0.658689460118681,-0.657375245794096,-0.656059028990507,-0.654740813717341,-0.653420603990106,-0.652098403830393,-0.650774217265851,-0.649448048330183,-0.648119901063131,-0.64678977951046,-0.645457687723951,-0.644123629761387,-0.64278760968654,-0.641449631569158,-0.640109699484956,-0.638767817515598,-0.63742398974869,-0.636078220277764,-0.634730513202268,-0.63338087262755,-0.632029302664852,-0.630675807431287,-0.629320391049838,-0.627963057649338,-0.626603811364461,-0.625242656335706,-0.623879596709386,-0.62251463663762,-0.621147780278311,-0.61977903179514,-0.618408395357555,-0.617035875140749,-0.615661475325658,-0.614285200098944,-0.612907053652976,-0.611527040185832,-0.610145163901268,-0.608761429008721,-0.607375839723287,-0.605988400265711,-0.604599114862375,-0.603207987745283,-0.601815023152048,-0.600420225325885,-0.599023598515586,-0.597625146975522,-0.596224874965616,-0.594822786751341,-0.593418886603702,-0.592013178799219,-0.590605667619926,-0.589196357353342,-0.587785252292473,-0.58637235673579,-0.584957674987216,-0.583541211356118,-0.58212297015729,-0.58070295571094,-0.57928117234268,-0.577857624383505,-0.576432316169794,-0.575005252043279,-0.573576436351046,-0.572145873445517,-0.570713567684432,-0.569279523430845,-0.567843745053102,-0.566406236924833,-0.564967003424939,-0.563526048937572,-0.562083377852132,-0.560638994563242,-0.559192903470747,-0.557745108979691,-0.556295615500305,-0.554844427448,-0.553391549243344,-0.551936985312058,-0.550480740084996,-0.549022817998132,-0.547563223492551,-0.54610196101443,-0.544639035015027,-0.543174449950671,-0.54170821028274,-0.540240320477656,-0.538770785006863,-0.537299608346824,-0.535826794978997,-0.534352349389827,-0.532876276070731,-0.531398579518084,-0.529919264233205,-0.528438334722348,-0.526955795496678,-0.525471651072268,-0.52398590597008,-0.522498564715949,-0.521009631840577,-0.519519111879509,-0.518027009373131,-0.516533328866642,-0.515038074910054,-0.51354125205817,-0.512042864870572,-0.510542917911606,-0.509041415750372,-0.507538362960704,-0.506033764121165,-0.504527623815019,-0.503019946630236,-0.501510737159458,-0.5,-0.498487739753831,-0.496973961027556,-0.495458668432408,-0.493941866584231,-0.492423560103467,-0.490903753615141,-0.489382451748847,-0.487859659138733,-0.486335380423491,-0.484809620246337,-0.483282383255003,-0.481753674101715,-0.48022349744319,-0.478691857940607,-0.477158760259609,-0.475624209070276,-0.474088209047117,-0.472550764869055,-0.471011881219411,-0.469471562785891,-0.467929814260574,-0.466386640339891,-0.464842045724621,-0.463296035119862,-0.461748613235034,-0.460199784783852,-0.458649554484315,-0.457097927058695,-0.455544907233516,-0.453990499739547,-0.452434709311783,-0.450877540689431,-0.449318998615897,-0.44775908783877,-0.446197813109809,-0.444635179184928,-0.44307119082418,-0.441505852791746,-0.439939169855915,-0.438371146789078,-0.436801788367703,-0.435231099372328,-0.433659084587545,-0.432085748801983,-0.430511096808295,-0.428935133403147,-0.427357863387193,-0.425779291565074,-0.424199422745391,-0.422618261740699,-0.421035813367492,-0.419452082446177,-0.417867073801078,-0.416280792260401,-0.414693242656239,-0.413104429824542,-0.411514358605109,-0.409923033841573,-0.408330460381386,-0.4067366430758,-0.405141586779863,-0.40354529635239,-0.401947776655961,-0.400349032556895,-0.398749068925247,-0.397147890634781,-0.395545502562966,-0.393941909590952,-0.392337116603562,-0.390731128489274,-0.389123950140207,-0.387515586452103,-0.385906042324319,-0.384295322659804,-0.38268343236509,-0.381070376350275,-0.379456159529005,-0.377840786818468,-0.376224263139366,-0.374606593415912,-0.372987782575809,-0.371367835550235,-0.36974675727383,-0.368124552684679,-0.366501226724297,-0.364876784337621,-0.363251230472979,-0.361624570082093,-0.359996808120052,-0.358367949545301,-0.356737999319626,-0.355106962408137,-0.353474843779258,-0.351841648404702,-0.350207381259468,-0.348572047321816,-0.346935651573256,-0.345298198998535,-0.343659694585617,-0.342020143325669,-0.340379550213051,-0.338737920245291,-0.337095258423083,-0.335451569750255,-0.333806859233771,-0.332161131883704,-0.330514392713224,-0.328866646738584,-0.327217898979105,-0.325568154457157,-0.32391741819815,-0.322265695230511,-0.320612990585677,-0.31895930929807,-0.317304656405092,-0.315649036947103,-0.313992455967405,-0.312334918512233,-0.310676429630732,-0.309016994374948,-0.307356617799807,-0.305695304963106,-0.304033060925491,-0.302369890750445,-0.300705799504273,-0.299040792256087,-0.297374874077786,-0.295708050044048,-0.294040325232304,-0.292371704722737,-0.290702193598253,-0.289031796944472,-0.287360519849713,-0.285688367404974,-0.284015344703923,-0.282341456842877,-0.280666708920788,-0.27899110603923,-0.277314653302378,-0.275637355816999,-0.273959218692433,-0.272280247040574,-0.270600445975865,-0.268919820615266,-0.267238376078257,-0.265556117486809,-0.263873049965373,-0.262189178640865,-0.260504508642649,-0.258819045102521,-0.257132793154697,-0.255445757935791,-0.253757944584807,-0.252069358243114,-0.250380004054442,-0.248689887164855,-0.246999012722744,-0.245307385878803,-0.243615011786023,-0.241921895599668,-0.240228042477265,-0.238533457578581,-0.236838146065619,-0.235142113102591,-0.233445363855905,-0.231747903494158,-0.230049737188104,-0.228350870110657,-0.226651307436855,-0.224951054343865,-0.223250116010952,-0.221548497619468,-0.219846204352838,-0.218143241396543,-0.216439613938103,-0.214735327167064,-0.213030386274977,-0.21132479645539,-0.209618562903822,-0.20791169081776,-0.20620418539663,-0.20449605184179,-0.202787295356513,-0.201077921145965,-0.199367934417197,-0.197657340379126,-0.195946144242518,-0.194234351219972,-0.192521966525908,-0.190808995376545,-0.189095442989892,-0.187381314585725,-0.185666615385578,-0.18395135061272,-0.182235525492148,-0.18051914525056,-0.17880221511635,-0.177084740319584,-0.175366726091988,-0.17364817766693,-0.171929100279411,-0.170209499166033,-0.168489379565004,-0.166768746716103,-0.165047605860677,-0.163325962241623,-0.161603821103361,-0.159881187691836,-0.158158067254484,-0.156434465040231,-0.154710386299468,-0.152985836284039,-0.15126082024722,-0.14953534344371,-0.147809411129611,-0.146083028562413,-0.144356201000973,-0.142628933705513,-0.140901231937583,-0.139173100960066,-0.137444546037147,-0.135715572434305,-0.133986185418293,-0.132256390257123,-0.130526192220052,-0.128795596577564,-0.127064608601351,-0.125333233564306,-0.123601476740493,-0.121869343405147,-0.120136838834648,-0.118403968306501,-0.116670737099334,-0.114937150492867,-0.113203213767907,-0.111468932206326,-0.109734311091046,-0.107999355706023,-0.106264071336234,-0.104528463267653,-0.102792536787248,-0.101056297182947,-0.0993197497436402,-0.0975828997591499,-0.0958457525202245,-0.0941083133185149,-0.0923705874465623,-0.090632580197781,-0.0888942968664424,-0.0871557427476583,-0.0854169231373686,-0.0836778433323158,-0.0819385086300414,-0.0801989243288595,-0.0784590957278447,-0.0767190281268194,-0.0749787268263277,-0.0732381971276327,-0.0714974443326861,-0.0697564737441256,-0.0680152906652486,-0.0662739004000007,-0.0645323082529586,-0.0627905195293142,-0.0610485395348569,-0.0593063735759626,-0.0575640269595675,-0.055821504993165,-0.0540788129847757,-0.0523359562429444,-0.050592940076714,-0.0488497697956131,-0.0471064507096435,-0.0453629881292539,-0.0436193873653362,-0.0418756537291999,-0.0401317925325601,-0.0383878090875205,-0.0366437087065569,-0.0348994967025008,-0.0331551783885271,-0.0314107590781284,-0.0296662440851118,-0.0279216387235692,-0.0261769483078735,-0.0244321781526537,-0.022687333572782,-0.0209424198833577,-0.0191974423996905,-0.0174524064372836,-0.0157073173118217,-0.0139621803391455,-0.0122170008352484,-0.0104717841162463,-0.00872653549837364,-0.00698126029796225,-0.0052359638314195,-0.00349065141522465,-0.00174532836589845
