-21504,-21504,-21504,-21504,-19712,-18688,-17920,-17408,-16640,-16384,-16384,-16384,-17408,-17920,-18688,-19712,-21248,-23040,-24576,-25856,-26624,-26624,-26368,-25600,-24576,-22784,-21760,-20480,-19712,-18432,-17408,-16896,-16384,-16896,-17408,-18688,-20736,-22016,-22528,-22528,-22528,-22016,-21504,-20224,-19200,-18176,-16640,-14336,-12544,-10496,-8704,-6400,-4608,-3584,-2304,-1280,0,1024,1792,2816,3584,3840,3840,3072,2304,1792,2048,2048,1792,1024,512,-512,-1792,-2304,-2816,-2304,-1792,-1280,-768,0,512,512,256,0,-512,0,256,256,0,-256,-512,-512,-256,3328,3840,5120,5888,5888,5888,6144,6656,7168,7936,8960,9472,9728,10240,10240,9984,9472,8448,7936,7424,7680,8448,8960,9472,9984,10496,10752,10752,11008,11264,11264,11008,10496,10240,10240,10240,10496,10752,10752,11520,11520,12032,12032,11264,10752,10240,9728,9216,8704,8448,8448,8448,8448,8448,8448,8704,8704,8704,8448,8448,8192,7936,7680,7680,7936,8448,8448,8448,8192,7936,7680,7168,6912,6400,6912,6912,7424,7680,7936,8192,8448,8192,7680,7168,6656,6144,6144,6144,6400,6912,7168,7424,7424,7168,6656,6144,5376,4352,3328,2560,2048,1792,1536,1280,1024,768,1280,1792,2304,3072,3840,5120,5888,6400,7168,7936,7936,8448,9472,9472,9984,10496,10752,11008,11008,10752,10496,10496,10496,10496,10496,10240,9984,9728,9472,9472,8448,7936,7680,7680,9472,10240,10496,10752,10752,11776,12544,13312,13312,13312,12544,11264,9984,8704,7168,5888,3840,2816,2304,1792,1280,1792,2304,2816,3072,3328,3328,3072,2304,1536,1024,0,2048,2560,2816,2816,2048,1024,0,-1024,-1536,-1792,-1792,-1536,-1280,0,1024,4864,8192,10240,10496,10752,12032,12288,12288,12032,11520,10752,10240,9472,8704,8192,7936,9472,10240,11520,12032,12288,11520,10752,10240,8192,7168,6912,7168,7168,7168,6912,7680,8704,9984,10752,11776,12800,13056,13568,14336,15360,15616,15104,13568,13056,12288,11776,11520,10752,11776,12032,12288,12288,13568,14336,15360,15872,15872,15616,15360,15360,15104,14848,14592,14080,13824,13312,12800,12800,12800,14080,16384,18432,19200,19712,20224,20224,19968,18688,17152,15872,14848,14848,14592,14080,13568,12800,12288,10496,8704,7424,4096,-3072,-7680,-8960,-9216,-9216,-9216,-9216,-9216,-9216,-8960,-8448,-8448,-8192,-7424,-5632,-3328,-2304,512,3584,5632,6912,7168,7168,6912,5888,4864,3840,3072,2304,1280,256,-1536,-2048,-2560,-2560,-3072,-4096,-5376,-6144,-6656,-6656,-5376,-4096,-4352,-3584,-2560,-2304,-2048,-1792,-1792,-2304,-2816,-3328,-3840,-3840,-3584,-3072,-2560,-1792,-1024,-768,-512,-1024,-1792,-2560,-3584,-3584,-3072,-2560,-1792,-3072,-4352,-5888,-6912,-7424,-7680,-7424,-7168,-6912,-6656,-6656,-7168,-7424,-7168,-6400,-5632,-5120,-4864,-4864,-5376,-5888,-5888,-5888,-5632,-5120,-4864,-4608,-4864,-5888,-5888,-5632,-5120,-4608,-4608,-5120,-5888,-5632,-5120,-4608,-4608,-4864,-5120,-5632,-5888,-5632,-5120,-4608,-4608,-4352,-4096,-4096,-4096,-4096,-3584,-3584,-3328,-3328,-3584,-4096,-4096,-3840,-3584,-3328,-4096,-6400,-8960,-10496,-10752,-10240,-9216,-8704,-8704,-9216,-10240,-11264,-12288,-13312,-13312,-13568,-13824,-13824,-13824,-13568,-13312,-13312,-13824,-15872,-18432,-20992,-23040,-25088,-26112,-26112,-26112,-25088,-24320,-22528,-21248,-21248,-21248,-21248,-21248,-21248,-21248,-21248,-21248,-21248,-21248,-21248
