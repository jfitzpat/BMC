-13312,-13312,-13312,-13312,-13824,-14080,-14080,-14080,-14080,-14080,-14080,-14080,-14080,-14080,-14080,-13824,-13312,-12544,-11008,-8960,-7424,-5632,-4352,-3072,-2304,-2304,-2304,-2816,-3328,-4352,-5376,-6144,-6656,-6144,-5376,-5120,-4608,-3840,-2816,-2304,-2304,-768,256,1792,2816,3584,4608,5632,6144,6400,6400,6400,5888,5376,4608,3840,2304,768,-256,-1280,-2048,-2304,-2304,-2816,-3072,-3584,-3328,-3328,-3072,-2304,-2048,-1792,-2048,-2560,-3072,-3584,-3584,-3328,-3072,-3072,-3072,-3072,-3072,-3072,-3328,-3840,-4096,-4096,-3840,-3584,-3328,-3328,-3584,-2560,-2304,-2048,-2048,-2048,-2048,-1536,-768,-256,256,512,256,0,-768,-1024,-1280,-1024,-1024,-1536,-2048,-2048,-2048,-2304,-2560,-2816,-3328,-3328,-3328,-3584,-3840,-4096,-4352,-4352,-4096,-3584,-3584,-3328,-3328,-3328,-3328,-3328,-3584,-3584,-3328,-3072,-3072,-3328,-3584,-4352,-4864,-5376,-5376,-5376,-5376,-4864,-4352,-4352,-3840,-3584,-3584,-3328,-3072,-3072,-3072,-3072,-3584,-3584,-3584,-3840,-3840,-3840,-3584,-3584,-3328,-3584,-3584,-3584,-3840,-4096,-4352,-4864,-5120,-5120,-4864,-4864,-4864,-5376,-5376,-5632,-5632,-5632,-5376,-5120,-4864,-4864,-4864,-4864,-4864,-4864,-4864,-5120,-5120,-4864,-4608,-4352,-4352,-4608,-5120,-5376,-5632,-5888,-6144,-6144,-6144,-6144,-6144,-5888,-5632,-5120,-5120,-5120,-4864,-5120,-5120,-5120,-5888,-6400,-6656,-6656,-6656,-6656,-6656,-6656,-6912,-7168,-7168,-6912,-6656,-6144,-6144,-5120,-4864,-4864,-5120,-5120,-5120,-5120,-5376,-6144,-6400,-7168,-7936,-8448,-8704,-8704,-8704,-8448,-8192,-7936,-7680,-7424,-7680,-7936,-7936,-7936,-7680,-7168,-6912,-6656,-6656,-6656,-7424,-6400,-6400,-6400,-6400,-6400,-6656,-7424,-8704,-10240,-11520,-12544,-13312,-14080,-14336,-14592,-14336,-12544,-11264,-10240,-9728,-9216,-8960,-8704,-9216,-9472,-9728,-9728,-9728,-9728,-9728,-9472,-9728,-9728,-9472,-8960,-8960,-9472,-9728,-9728,-13056,-16128,-18176,-18688,-18688,-18688,-18688,-18688,-18688,-18432,-18176,-17664,-16896,-16384,-15616,-14592,-11776,-10752,-8192,-6144,-5632,-5120,-5120,-5120,-5120,-5120,-4352,-3584,-3584,-3584,-3840,-4608,-5632,-7168,-8192,-9472,-10496,-11776,-12544,-13824,-14848,-15360,-16128,-16640,-16640,-16640,-16640,-16640,-16640,-16640,-16384,-16128,-16128,-15616,-14336,-13312,-12800,-12800,-12800,-13568,-14848,-15616,-16640,-17152,-18176,-18688,-18944,-19200,-18688,-16896,-15872,-14848,-12800,-12800,-13312,-14848,-15872,-17152,-18176,-18176,-18432,-18944,-19712,-20480,-20736,-20736,-20736,-20480,-20224,-19968,-19456,-18688,-17920,-17152,-16384,-15872,-15616,-15616,-15872,-16384,-16640,-17408,-17408,-17408,-17152,-16896,-16640,-16640,-16640,-16896,-17152,-15872,-15104,-15360,-15872,-16384,-16640,-16640,-15872,-14848,-13568,-12032,-10240,-8704,-6912,-5632,-4864,-4096,-3840,-3584,-4096,-4864,-5632,-5376,-4864,-4352,-4096,-3840,-4352,-5120,-6912,-8960,-10752,-13056,-14848,-15872,-16384,-16896,-16896,-15872,-14848,-13568,-13056,-12800,-13056,-13312,-14336,-14336,-14080,-13568,-13312,-13056,-13056,-13312,-13824,-14336,-14080,-13568,-13056,-11776,-9728,-8704,-8448,-9472,-9984,-9984,-9472,-8960,-8704,-8448,-8704,-9472,-9984,-9984,-8960,-8960,-7936,-7168,-6144,-5888,-5888,-5376,-5376,-5632,-5888,-6144,-6144,-5888,-5376,-5376,-5888,-6912,-8704,-11008,-14336,-15616,-16384,-16640,-16896,-16896,-16640,-16384,-16128,-15872,-15616,-15360,-14848,-14080,-14080,-14080,-14848,-15360,-16128,-16640,-17152,-17152,-17152,-16896,-16384,-15872,-15872,-15872,-14848,-14336,-13568,-13312,-13312,-13312,-13312,-13312,-13312,-13312,-13312,-13312,-13312,-13312,-13312
